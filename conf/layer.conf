## conf/layer.conf
```bitbake
# We have a conf and classes directory, add to BBPATH
BBPATH .= ":${LAYERDIR}"

# We have recipes-* directories, add to BBFILES
BBFILES += "${LAYERDIR}/recipes-silkit/**/*.bb \
            ${LAYERDIR}/recipes-silkit/**/*.bbappend"

BBFILE_COLLECTIONS += "meta-silkit"
BBFILE_PATTERN_meta-silkit = "^${LAYERDIR}/"
BBFILE_PRIORITY_meta-silkit = "6"

LAYERDEPENDS_meta-silkit = "core"
LAYERSERIES_COMPAT_meta-silkit = "scarthgap"
```
